## arch/riscv32/soc/riscv-privilege/ev/Kconfig.defconfig.series
```kconfig
if SOC_SERIES_RISCV32_EV

config SOC_SERIES
	string
	default "ev"

config SYS_CLOCK_HW_CYCLES_PER_SEC
	int
	default 50000000

config RISCV_SOC_INTERRUPT_INIT
	bool
	default n

config RISCV_HAS_CPU_IDLE
	bool
	default n

config RISCV_HAS_PLIC
	bool
	default n

config NUM_IRQS
	int
	default 8

config XIP
	bool
	default y

config RISCV_ROM_BASE_ADDR
	hex
	default 0x0000

config RISCV_ROM_SIZE
	hex
	default 0x5000

config RISCV_RAM_BASE_ADDR
	hex
	default	0x5000

config RISCV_RAM_SIZE
	hex
	default 0x2000

endif # SOC_SERIES_RISCV32_EV
```

## arch/riscv32/soc/riscv-privilege/ev/Kconfig.series
```kconfig
# Kconfig - RISCV32_EV implementation
#
# Copyright (c) 2018 MicroFPGA UG
#

config SOC_SERIES_RISCV32_EV
	bool "MicroFPGA engine-V implementation"
	depends on RISCV32
	select SOC_FAMILY_RISCV_PRIVILEGE
	help
	Enable support for MicroFPGA engine-V
```

## arch/riscv32/soc/riscv-privilege/ev/Kconfig.soc
```kconfig
# Kconfig - RISCV32_EV configuration options
#
# Copyright (c) 2018 MicroFPGA UG
#

choice
prompt "MicroFPGA engine-V system implementation"
depends on SOC_SERIES_RISCV32_EV

config SOC_RISCV32_EV
	bool "MicroFPGA engine-V system implementation"


endchoice
```

## boards/riscv32/m2gl025_ev/Kconfig.board
```kconfig
config BOARD_M2GL025_EV
	bool "Microsemi M2GL025 IGLOO2 dev board with engine-V CPU"
	depends on SOC_RISCV32_EV
```

## boards/riscv32/m2gl025_ev/m2gl025_ev_defconfig
```kconfig
CONFIG_RISCV32=y
CONFIG_SOC_SERIES_RISCV32_EV=y
CONFIG_SOC_RISCV32_EV=y
CONFIG_BOARD_M2GL025_EV=y
CONFIG_CONSOLE=y
CONFIG_SERIAL=y
CONFIG_UART_EV=y
CONFIG_UART_EV_PORT_0=y
CONFIG_UART_EV_PORT_0_NAME="uart0"
CONFIG_UART_CONSOLE=y
CONFIG_UART_CONSOLE_ON_DEV_NAME="uart0"
CONFIG_PLIC=n
CONFIG_RISCV_MACHINE_TIMER=y
CONFIG_GPIO=n
CONFIG_XIP=y
```

## drivers/serial/Kconfig.ev
```kconfig
# Kconfig.ev - engine-V UART configuration option
#
# Copyright (c) 2018 MicroFPGA UG
#
# SPDX-License-Identifier: Apache-2.0
#

menuconfig UART_EV
	bool "engine-V UART driver"
	depends on SOC_RISCV32_EV
	select SERIAL_HAS_DRIVER
	help
          Enable the engine-V UART driver.

menuconfig UART_EV_PORT_0
	bool "Enable engine-V Port 0"
	depends on UART_EV
	help
	  This tells the driver to configure the UART port at boot, depending on
	  the additional configuration options below.

config UART_EV_PORT_0_NAME
	string "Port 0 Device Name"
	default "uart0"
	depends on UART_EV_PORT_0
	help
	  This is the device name for UART, and is included in the device
	  struct.
```
